## config/west.yml
```yaml
manifest:
  remotes:
    - name: zmkfirmware
      url-base: https://github.com/zmkfirmware
    - name: urob
      url-base: https://github.com/urob
    - name: howson
      url-base: https://github.com/James-o-Howson
  projects:
    - name: zmk
      remote: howson
      revision: main
      import: app/west.yml
  self:
    path: config
```
